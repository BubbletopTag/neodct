## buildroot/package/fbrowser/Config.in
```kconfig
config BR2_PACKAGE_FBROWSER
    bool "fbrowser"
    depends on BR2_PACKAGE_QT5
    depends on BR2_PACKAGE_QT5WEBKIT
    help
      QtWebKit-based web browser for Linux framebuffer.
      
      https://github.com/shownb/FBrowser
```

## buildroot/package/libnsfb/Config.in
```kconfig
config BR2_PACKAGE_LIBNSFB
    bool "libnsfb"
    select BR2_PACKAGE_NETSURF_BUILDSYSTEM
    help
      Framebuffer abstraction library for NetSurf.
      
      http://www.netsurf-browser.org/projects/libnsfb/

if BR2_PACKAGE_LIBNSFB

config BR2_PACKAGE_LIBNSFB_LINUX
    bool "Linux Framebuffer surface"
    help
      Enable the Linux Framebuffer surface backend.

endif
```

## buildroot/package/netsurf-buildsystem/Config.in
```kconfig
config BR2_PACKAGE_NETSURF_BUILDSYSTEM
    bool "netsurf-buildsystem"
    help
      Shared build system for NetSurf libraries.
```

## neodct/configs/neodct_radxa_defconfig
```kconfig
BR2_aarch64=y
BR2_cortex_a55=y
BR2_KERNEL_HEADERS_6_18=y
BR2_TOOLCHAIN_BUILDROOT_CXX=y
BR2_TARGET_GENERIC_HOSTNAME="neodct"
BR2_TARGET_GENERIC_ISSUE="NeoDCT System v0.14a Pre-M1 REAL HARDWARE TEST 1"
BR2_ROOTFS_DEVICE_CREATION_DYNAMIC_EUDEV=y
BR2_ROOTFS_OVERLAY="board/radxa/zero3w/overlay"
BR2_ROOTFS_POST_BUILD_SCRIPT="suppor/scripts/genimage.sh"
BR2_ROOTFS_POST_SCRIPT_ARGS="-c board/radxa/zero3w/genimage.cfg"
BR2_LINUX_KERNEL=y
BR2_LINUX_KERNEL_DEFCONFIG="rockchip/rk3566-radxa-zero-3w"
BR2_LINUX_KERNEL_DTS_SUPPORT=y
BR2_LINUX_KERNEL_INTREE_DTS_NAME="rockchip/rk3566-radxa-zero-3w"
BR2_TARGET_ARM_TRUSTED_FIRMWARE=y
BR2_TARGET_ARM_TRUSTED_FIRMWARE_PLATFORM="rk3566"
BR2_TARGET_ARM_TRUSTED_FIRMWARE_BL31=y
BR2_TARGET_ARM_TRUSTED_FIRMWARE_IMAGES="bl31.elf"
BR2_TARGET_UBOOT=y
BR2_TARGET_UBOOT_BOARD_DEFCONFIG="radxia-zero-3w-rk3566"
BR2_TARGET_UBOOT_FORMAT_ITB=y
BR2_TARGET_UBOOT_SPL=y
BR2_TARGET_UBOOT_SPL_NAME="idbloaer.img"
BR2_TARGET_UBOOT_CUSTOM_MAKEOPTS="BL31=$(BINARIES_DIR)/bl31.elf"
BR2_PACKAGE_HOST_GENIMAGE=y
```
